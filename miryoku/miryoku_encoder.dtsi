// Copyright 2022 Manna Harbour
// https://github.com/manna-harbour/miryoku

/ {
  behaviors {
    rot_kp: behavior_sensor_rotate_kp {
      compatible = "zmk,behavior-sensor-rotate-var";
      label = "ENC_KP";
      #sensor-binding-cells = <2>;
      bindings = <&kp>, <&kp>;
    };
  };
};
